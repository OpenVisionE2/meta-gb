## conf/machine/gb800se.conf
```bitbake
#@TYPE: Machine
#@NAME: GigaBlue 800 SE
#@DESCRIPTION: Machine configuration for GigaBlue 800 SE

IMAGEDIR = "gigablue/se"

require conf/machine/include/gigablue-gb7325.inc

MACHINE_FEATURES += "eDBoxLCD"

DISPLAY_MODEL = "800 SE"
```

## conf/machine/gb800ue.conf
```bitbake
#@TYPE: Machine
#@NAME: GigaBlue 800 UE
#@DESCRIPTION: Machine configuration for GigaBlue 800 UE

IMAGEDIR = "gigablue/ue"

require conf/machine/include/gigablue-gb7325.inc

MACHINE_FEATURES += "colorlcd220 gigabluelcd gigabluelcd220"

DISPLAY_MODEL = "800 UE"
```

## conf/machine/include/gigablue-oem.inc
```bitbake
# We know about rtc
MACHINE_FEATURES_BACKFILL_CONSIDERED += "rtc"

BOX_BRAND = "gigablue"

KERNEL_FILE = "kernel.bin"

MACHINE_ESSENTIAL_EXTRA_RDEPENDS += "\
	gigablue-ddbootup \
	${@bb.utils.contains("MACHINE_FEATURES", "smallflash", "", " \
	kernel-module-rtl8192cu \
	firmware-rtl8192cu \
	firmware-rtl8192cufw \
	kernel-module-extrawlan-rtl8192eu \
	firmware-rtl8192eu \
	kernel-module-extrawlan-rt8812au \
	kernel-module-extrawlan-rt8822bu", d)} \
	gstreamer1.0-plugin-dvbmediasink \
	gigablue-cfe \
	"

DVBPROVIDER = "kernel"

PREFERRED_PROVIDER_virtual/kernel = "linux-gigablue"

KERNEL_OUTPUT = "${KERNEL_IMAGETYPE}"
KERNEL_CONSOLE = "ttyS0,115200n8"

MACHINE_FEATURES += "alsa hdmicec switchoff blindscan-tbs gigablue HDMI"

BOOTLOGO_FILENAME = "splash.bin"

require conf/machine/include/soc-family.inc

BLINDSCAN_BINARY = "gigablue_blindscan"

RCNAME ?= "gb0"
```
